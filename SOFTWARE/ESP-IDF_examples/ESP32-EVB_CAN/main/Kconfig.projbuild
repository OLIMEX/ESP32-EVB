## SOFTWARE/ESP-IDF_examples/ESP32-EVB_CAN/main/Kconfig.projbuild
```kconfig
menu "Example Configuration"

    config EXAMPLE_GPIO_RANGE_MIN
        int
        default 0

    config EXAMPLE_GPIO_RANGE_MAX
        int
        default 33 if IDF_TARGET_ESP32
        default 46 if IDF_TARGET_ESP32S2
        default 19 if IDF_TARGET_ESP32C3
        default 48 if IDF_TARGET_ESP32S3

 endmenu
```
